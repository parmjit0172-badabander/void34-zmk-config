## config/boards/shields/enki42/Kconfig.defconfig
```kconfig
if SHIELD_ENKI42_LEFT || SHIELD_ENKI42_RIGHT

config ZMK_SPLIT
	default y

config ZMK_BLE
	default y

endif

if SHIELD_ENKI42_LEFT

config ZMK_KEYBOARD_NAME
	default "Void 34 Left"

config ZMK_SPLIT_BLE_ROLE_CENTRAL
	default y

config ZMK_USB
	default y

endif
```

## config/boards/shields/enki42/Kconfig.shield
```kconfig
config SHIELD_ENKI42_LEFT
	def_bool $(shields_list_contains,enki42_left)

config SHIELD_ENKI42_RIGHT
	def_bool $(shields_list_contains,enki42_right)
```

## config/boards/shields/void34/Kconfig.defconfig
```kconfig
if SHIELD_VOID34_CORE

config ZMK_KEYBOARD_NAME
    default "V01D C0R3"

config ZMK_SPLIT_BLE_ROLE_CENTRAL
    default y

config ZMK_USB
    default y

endif

if SHIELD_VOID34_LEFT || SHIELD_VOID34_RIGHT

config ZMK_SPLIT
    default y

config ZMK_BLE
    default y

endif
```

## config/boards/shields/void34/Kconfig.shield
```kconfig
config SHIELD_VOID34_LEFT
    def_bool $(shields_list_contains,void34_left)

config SHIELD_VOID34_RIGHT
    def_bool $(shields_list_contains,void34_right)

config SHIELD_VOID34_CORE
    def_bool $(shields_list_contains,void34_core)
```
